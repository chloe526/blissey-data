## firmware/esp32-csi-tool/active_ap/sdkconfig.defaults
```kconfig
CONFIG_ESP32_WIFI_CSI_ENABLED=y
CONFIG_ESPTOOLPY_MONITOR_BAUD_OTHER=y
CONFIG_ESPTOOLPY_MONITOR_BAUD_OTHER_VAL=921600
CONFIG_ESP_CONSOLE_UART_BAUDRATE=921600
CONFIG_FREERTOS_HZ=1000
CONFIG_WIFI_CHANNEL=6
CONFIG_SHOULD_COLLECT_CSI=y
CONFIG_SHOULD_COLLECT_ONLY_LLTF=y
CONFIG_SEND_CSI_TO_SERIAL=y
# CONFIG_SEND_CSI_TO_SD is not set
```

## firmware/esp32-csi-tool/active_sta/sdkconfig.defaults
```kconfig
CONFIG_ESP32_WIFI_CSI_ENABLED=y
CONFIG_ESPTOOLPY_MONITOR_BAUD_OTHER=y
CONFIG_ESPTOOLPY_MONITOR_BAUD_OTHER_VAL=921600
CONFIG_ESP_CONSOLE_UART_BAUDRATE=921600
CONFIG_FREERTOS_HZ=1000
CONFIG_WIFI_CHANNEL=6
CONFIG_PACKET_RATE=100
# CONFIG_SHOULD_COLLECT_CSI is not set
# CONFIG_SEND_CSI_TO_SERIAL is not set
# CONFIG_SEND_CSI_TO_SD is not set
```
